## drivers/input/touchscreen/gt917d/Kconfig
```kconfig
#
# Goodix GT917D Touchscreen driver
#
config TOUCHSCREEN_GT917D
	bool "Goodix touchpanel GT917D series"
	depends on I2C
	help
	  Say Y here if you have a Goodix GT917D touchscreen
	  controller.

          If unsure, say N.

config TOUCHSCREEN_GT917D_UPDATE
	tristate "Goodix GT917D touch controller auto update support"
	depends on TOUCHSCREEN_GT917D
	default y
	help
	  Enable this for support firmware update.

	  Say Y here if you want update touch controller firmware.

	  If unsure, say N.

config TOUCHSCREEN_GT917d_TOOL
	tristate "Goodix GT917D Tools for debuging"
	depends on TOUCHSCREEN_GT917D
	default y
	help
	  This implement interface support for Goodix GT917D
	  touchscreen debug.

	  Say Y here if you want to have a Android app debug interface
	  to your system.

	  If unsure, say N.
```
